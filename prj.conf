## CMakeLists.txt
```
cmake_minimum_required(VERSION 3.8.2)
set(BOARD nrf52840_pca10059)
set(CONF_FILE "prj.conf")
include($ENV{ZEPHYR_BASE}/cmake/app/boilerplate.cmake NO_POLICY_SCOPE)

project(my_zigbee)

target_include_directories(app PRIVATE $ENV{ZEPHYR_BASE}/subsys/net/ip)

FILE(GLOB app_sources src/*.c)
target_sources(app PRIVATE ${app_sources})
```

## prj.conf
```kconfig
CONFIG_STDOUT_CONSOLE=y
CONFIG_GPIO=y
CONFIG_USB=y
CONFIG_USB_DEVICE_STACK=y
CONFIG_USB_DEVICE_PRODUCT="Zephyr CDC ACM sample"
CONFIG_LOG=y
CONFIG_USB_DRIVER_LOG_LEVEL_ERR=y
CONFIG_USB_CDC_ACM=y
CONFIG_USB_DEVICE_LOG_LEVEL_ERR=y
CONFIG_SERIAL=y
CONFIG_UART_INTERRUPT_DRIVEN=y
CONFIG_UART_LINE_CTRL=y

CONFIG_BT=y
CONFIG_BT_DEBUG_LOG=y
CONFIG_BT_DEVICE_NAME="Test beacon"
```

## overlay-nrf52840_pca10059.conf
```kconfig
CONFIG_IEEE802154_NRF5=y
CONFIG_IEEE802154_NRF5_DRV_NAME="IEEE802154_nrf5"
CONFIG_IEEE802154_NRF5_INIT_PRIO=80
CONFIG_NET_CONFIG_IEEE802154_DEV_NAME="IEEE802154_nrf5"
```

## src/main.c
```c
/*
 * Copyright (c) 2016 Intel Corporation
 *
 * SPDX-License-Identifier: Apache-2.0
 */

/**
 * @file
 * @brief Sample app for CDC ACM class driver
 *
 * Sample app for USB CDC ACM class driver. The received data is echoed back
 * to the serial port.
 */

#include <stdio.h>
#include <string.h>
#include <device.h>
#include <uart.h>
#include <zephyr.h>

#include <gpio.h>

#include <zephyr/types.h>
#include <stddef.h>
#include <misc/printk.h>
#include <misc/util.h>
#include <bluetooth/bluetooth.h>
#include <bluetooth/hci.h>

#define DEVICE_NAME CONFIG_BT_DEVICE_NAME
#define DEVICE_NAME_LEN (sizeof(DEVICE_NAME) - 1)

/*
 * Set Advertisement data. Based on the Eddystone specification:
 * https://github.com/google/eddystone/blob/master/protocol-specification.md
 * https://github.com/google/eddystone/tree/master/eddystone-url
 */
static const struct bt_data ad[] = {
    BT_DATA_BYTES(BT_DATA_FLAGS, BT_LE_AD_NO_BREDR),
    BT_DATA_BYTES(BT_DATA_UUID16_ALL, 0xaa, 0xfe),
    BT_DATA_BYTES(BT_DATA_SVC_DATA16,
              0xaa, 0xfe, /* Eddystone UUID */
              0x10, /* Eddystone-URL frame type */
              0x00, /* Calibrated Tx power at 0m */
              0x00, /* URL Scheme Prefix http://www. */
              'z', 'e', 'p', 'h', 'y', 'r',
              'p', 'r', 'o', 'j', 'e', 'c', 't',
              0x08) /* .org */
};

/* Set Scan Response data */
static const struct bt_data sd[] = {
    BT_DATA(BT_DATA_NAME_COMPLETE, DEVICE_NAME, DEVICE_NAME_LEN),
};


static void bt_ready(int err)
{
    if (err) {
        printk("Bluetooth init failed (err %d)\n", err);
        return;
    }

    printk("Bluetooth initialized\n");

    /* Start advertising */
    err = bt_le_adv_start(BT_LE_ADV_NCONN, ad, ARRAY_SIZE(ad),
                  sd, ARRAY_SIZE(sd));
    if (err) {
        printk("Advertising failed to start (err %d)\n", err);
        return;
    }

    printk("Beacon started\n");
}


static const char *banner1 = "All your base are belong to us\n";

static volatile bool data_transmitted;
static volatile bool data_arrived;
static	char data_buf[64];

static void interrupt_handler(struct device *dev)
{
	uart_irq_update(dev);

	if (uart_irq_tx_ready(dev)) {
		data_transmitted = true;
	}

	if (uart_irq_rx_ready(dev)) {
		data_arrived = true;
	}
}

static void write_data(struct device *dev, const char *buf, int len)
{
	uart_irq_tx_enable(dev);

	while (len) {
		int written;

		data_transmitted = false;
		written = uart_fifo_fill(dev, (const u8_t *)buf, len);
		while (data_transmitted == false) {
			k_yield();
		}

		len -= written;
		buf += written;
	}

	uart_irq_tx_disable(dev);
}

static void read_and_echo_data(struct device *dev, int *bytes_read)
{
    int t = 100;
	while (t && data_arrived == false)
    {
        t--;
    }

	data_arrived = false;

	/* Read all data and echo it back */
	while ((*bytes_read = uart_fifo_read(dev,
	    (u8_t *)data_buf, sizeof(data_buf)))) {
		write_data(dev, data_buf, *bytes_read);
	}
}

void main(void)
{

	struct device *dev;
	u32_t baudrate, bytes_read, dtr = 0U;
	int ret;
	dev = device_get_binding(CONFIG_CDC_ACM_PORT_NAME_0);
	if (!dev) {
		printf("CDC ACM device not found\n");
		return;
	}

    int t = 100;
	printf("Wait for DTR\n");
	while (t) {
		uart_line_ctrl_get(dev, LINE_CTRL_DTR, &dtr);
		if (dtr)
			break;
        t--;
	}
	printf("DTR set, start test\n");

	ret = uart_line_ctrl_set(dev, LINE_CTRL_DCD, 1);
	if (ret)
		printf("Failed to set DCD, ret code %d\n", ret);
	ret = uart_line_ctrl_set(dev, LINE_CTRL_DSR, 1);
	if (ret)
		printf("Failed to set DSR, ret code %d\n", ret);

	k_busy_wait(1000000);

	ret = uart_line_ctrl_get(dev, LINE_CTRL_BAUD_RATE, &baudrate);
	if (ret)
		printf("Failed to get baudrate, ret code %d\n", ret);
	else
		printf("Baudrate detected: %d\n", baudrate);

	uart_irq_callback_set(dev, interrupt_handler);
	write_data(dev, banner1, strlen(banner1));

	uart_irq_rx_enable(dev);
    int err;

    printk("Starting Beacon Demo\n");

    err = bt_enable(bt_ready);
    if (err) {
        printk("Bluetooth init failed (err %d)\n", err);
    }

    struct device *dev_led;
    int cnt = 1;
    dev_led = device_get_binding(LED0_GPIO_CONTROLLER);
    gpio_pin_configure(dev_led, LED0_GPIO_PIN, GPIO_DIR_OUT); 

	/* Echo the received data */
	while (1) {
        gpio_pin_write(dev_led, LED0_GPIO_PIN, cnt % 2);
        cnt++;
        k_sleep(1000);
		read_and_echo_data(dev, (int *) &bytes_read);
	}
}
```

## src/my_zigbee.c
```c
/*
 * Copyright (c) 2016 Intel Corporation
 *
 * SPDX-License-Identifier: Apache-2.0
 */


#include <net_private.h>

#include <device.h>

#include <net/buf.h>
#include <net/ieee802154_radio.h>

#include "my_zigbee.h"

#include <zephyr.h>
#include <board.h>
#include <gpio.h>

#include "usb_acm.h"

/* Change this if you have an LED connected to a custom port */
#ifndef LED0_GPIO_CONTROLLER
#define LED0_GPIO_CONTROLLER 	LED0_GPIO_PORT
#endif

#define LED_PORT LED0_GPIO_CONTROLLER

/* Change this if you have an LED connected to a custom pin */
#define LED	LED0_GPIO_PIN

/* 1000 msec = 1 sec */
#define SLEEP_TIME 	1000



/* Max Bluetooth command data size */
#define BLE_ZIGBEE_CLASS_MAX_DATA_SIZE	100

static struct ieee802154_radio_api *radio_api;
static struct device *ieee802154_dev;

static struct k_fifo tx_queue;

/**
 * Stack for the tx thread.
 */
static K_THREAD_STACK_DEFINE(tx_stack, 1024);
static struct k_thread tx_thread_data;

static int set_channel(void *data, int len)
{
	struct set_channel *req = data;

	SEGGER_SYSVIEW_PrintfHost("page %u channel %u", req->page, req->channel);

	return radio_api->set_channel(ieee802154_dev, req->channel);
}

static int set_ieee_addr(void *data, int len)
{
	struct set_ieee_addr *req = data;

	SEGGER_SYSVIEW_PrintfHost("len %u", len);

	if (IEEE802154_HW_FILTER &
	    radio_api->get_capabilities(ieee802154_dev)) {
		struct ieee802154_filter filter;

		filter.ieee_addr = (u8_t *)&req->ieee_addr;

		return radio_api->filter(ieee802154_dev, true,
					 IEEE802154_FILTER_TYPE_IEEE_ADDR,
					 &filter);
	}

	return 0;
}

static int set_short_addr(void *data, int len)
{
	struct set_short_addr *req = data;

	SEGGER_SYSVIEW_PrintfHost("len %u", len);


	if (IEEE802154_HW_FILTER &
	    radio_api->get_capabilities(ieee802154_dev)) {
		struct ieee802154_filter filter;

		filter.short_addr = req->short_addr;

		return radio_api->filter(ieee802154_dev, true,
					 IEEE802154_FILTER_TYPE_SHORT_ADDR,
					 &filter);
	}

	return 0;
}

static int set_pan_id(void *data, int len)
{
	struct set_pan_id *req = data;

	SEGGER_SYSVIEW_PrintfHost("len %u", len);

	if (IEEE802154_HW_FILTER &
	    radio_api->get_capabilities(ieee802154_dev)) {
		struct ieee802154_filter filter;

		filter.pan_id = req->pan_id;

		return radio_api->filter(ieee802154_dev, true,
					 IEEE802154_FILTER_TYPE_PAN_ID,
					 &filter);
	}

	return 0;
}

static int start(void)
{
	SEGGER_SYSVIEW_PrintfHost("Start IEEE 802.15.4 device");

	return radio_api->start(ieee802154_dev);
}

static int stop(void)
{
	SEGGER_SYSVIEW_PrintfHost("Stop IEEE 802.15.4 device");

	return radio_api->stop(ieee802154_dev);
}

static int tx(struct net_pkt *pkt)
{
	struct net_buf *buf = net_buf_frag_last(pkt->frags);
	u8_t seq = net_buf_pull_u8(buf);
	int retries = 3;
	int ret;

	SEGGER_SYSVIEW_PrintfHost("len %d seq %u", buf->len, seq);

	do {
		ret = radio_api->tx(ieee802154_dev, pkt, buf);
	} while (ret && retries--);

	if (ret) {
		/* Send seq = 0 for unsuccessful send */
		seq = 0;
	}

	/*try_write(WPANUSB_ENDP_BULK_IN, &seq, sizeof(seq)); */

	return ret;
}


static void tx_thread(void)
{
	SEGGER_SYSVIEW_PrintfHost("Tx thread started");

	while (1) {
		u8_t cmd;
		struct net_pkt *pkt;
		struct net_buf *buf;

		pkt = k_fifo_get(&tx_queue, K_FOREVER);
		buf = net_buf_frag_last(pkt->frags);
		cmd = net_buf_pull_u8(buf);

		net_hexdump(">", buf->data, buf->len);

		switch (cmd) {
		case RESET:
			SEGGER_SYSVIEW_PrintfHost("Reset device");
			break;
		case TX:
			tx(pkt);
			break;
		case START:
			start();
			break;
		case STOP:
			stop();
			break;
		case SET_CHANNEL:
			set_channel(buf->data, buf->len);
			break;
		case SET_IEEE_ADDR:
			set_ieee_addr(buf->data, buf->len);
			break;
		case SET_SHORT_ADDR:
			set_short_addr(buf->data, buf->len);
			break;
		case SET_PAN_ID:
			set_pan_id(buf->data, buf->len);
			break;
		default:
			SEGGER_SYSVIEW_PrintfHost("%x: Not handled for now", cmd);
			break;
		}

		net_pkt_unref(pkt);

		k_yield();
	}
}



static void init_tx_queue(void)
{
	/* Transmit queue init */
	k_fifo_init(&tx_queue);

	k_thread_create(&tx_thread_data, tx_stack,
			K_THREAD_STACK_SIZEOF(tx_stack),
			(k_thread_entry_t)tx_thread,
			NULL, NULL, NULL, K_PRIO_COOP(8), 0, K_NO_WAIT);
}

/**
 * Interface to the network stack, will be called when the packet is
 * received
 */
int net_recv_data(struct net_if *iface, struct net_pkt *pkt)
{
	struct net_buf *frag;

	frag = net_buf_frag_last(pkt->frags);

	/**
	 * Add length 1 byte, do not forget to reserve it
	 */
	net_buf_push_u8(frag, net_pkt_get_len(pkt));

	/**
	 * Add LQI at the end of the packet
	 */
	net_buf_add_u8(frag, net_pkt_ieee802154_lqi(pkt));

	net_hexdump("<", frag->data, net_pkt_get_len(pkt));

	/*try_write(WPANUSB_ENDP_BULK_IN, frag->data, net_pkt_get_len(pkt));*/

	net_pkt_unref(pkt);

	return 0;
}

void main(void)
{
	SEGGER_SYSVIEW_Conf();
	SEGGER_SYSVIEW_Start();	

	ieee802154_dev = device_get_binding(CONFIG_NET_CONFIG_IEEE802154_DEV_NAME);
	if (!ieee802154_dev) {
		SEGGER_SYSVIEW_PrintfHost("Cannot get IEEE802.15.4 device");
		return;
	}

	radio_api = (struct ieee802154_radio_api *)ieee802154_dev->driver_api;
	
	SEGGER_SYSVIEW_PrintfHost("IEEE802.15.4 radio initialized!");
	/* Initialize net_pkt */
	net_pkt_init();

	/* Initialize transmit queue */
	init_tx_queue();
	radio_api = (struct ieee802154_radio_api *)ieee802154_dev->driver_api;

	/* TODO: Initialize more */

	SEGGER_SYSVIEW_PrintfHost("radio_api %p initialized", radio_api);

	int cnt = 0;
	struct device *dev;

	dev = device_get_binding(LED_PORT);
	/* Set LED pin as output */
	gpio_pin_configure(dev, LED, GPIO_DIR_OUT);

	struct device* usb_acm_dev;
	usb_acm_setup(&usb_acm_dev);

	while (1) {
		write_data(usb_acm_dev, "a", 1);
		/* Set pin to HIGH/LOW every 1 second */
		gpio_pin_write(dev, LED, cnt % 2);
		cnt++;
		k_sleep(SLEEP_TIME);
	}
}
```

## src/usb_acm.c
```c
#include <stdio.h>
#include <string.h>

#include <device.h>
#include <uart.h>
#include <zephyr.h>
#include <uart.h>
#include "usb_acm.h"

static const char *banner1 = "Send characters to the UART device\r\n";
static const char *banner2 = "Characters read:\r\n";

static volatile bool data_transmitted;
static volatile bool data_arrived;
static	char data_buf[64];

#define CONFIG_CDC_ACM_PORT_NAME_O "CDC_ACM"

int usb_acm_setup(struct device** dev)
{
	u32_t baudrate, dtr = 0;
	int ret;
	(*dev) = device_get_binding("CDC_ACM");
	if (!dev) {
		/*printf("CDC ACM device not found\n");*/
		return -1;
	}
	while (1) {
		uart_line_ctrl_get((*dev), LINE_CTRL_DTR, &dtr);
		if (dtr)
			break;
	}
	/* They are optional, we use them to test the interrupt endpoint */
	ret = uart_line_ctrl_set((*dev), LINE_CTRL_DCD, 1);
	if (ret)
	{
		return -2;
		/*printf("Failed to set DCD, ret code %d\n", ret);*/
	}

	ret = uart_line_ctrl_set((*dev), LINE_CTRL_DSR, 1);
	if (ret)
	{
		return -3;
		/*printf("Failed to set DSR, ret code %d\n", ret);*/
	}

	/* Wait 1 sec for the host to do all settings */
	k_busy_wait(1000000);

	ret = uart_line_ctrl_get((*dev), LINE_CTRL_BAUD_RATE, &baudrate);
	if (ret)
	{
		return -4;
		/*printf("Failed to get baudrate, ret code %d\n", ret);*/
	}
	
	/*printf("Baudrate detected: %d\n", baudrate);*/

	uart_irq_callback_set((*dev), interrupt_handler);
	write_data((*dev), banner1, strlen(banner1));
	write_data((*dev), banner2, strlen(banner2));

	/* Enable rx interrupts */
	uart_irq_rx_enable(*dev);
	return (int) 0;
}

void interrupt_handler(struct device *dev)
{
	uart_irq_update(dev);

	if (uart_irq_tx_ready(dev)) {
		data_transmitted = true;
	}

	if (uart_irq_rx_ready(dev)) {
		data_arrived = true;
	}
}
 
void write_data(struct device *dev, const char *buf, int len)
{
	uart_irq_tx_enable(dev);

	while (len) {
		int written;

		data_transmitted = false;
		written = uart_fifo_fill(dev, (const u8_t *)buf, len);
		while (data_transmitted == false) {
			k_yield();
		}

		len -= written;
		buf += written;
	}

	uart_irq_tx_disable(dev);
}

void read_and_echo_data(struct device *dev, int *bytes_read)
{
	char c = '\n';
	
	while (data_arrived == false)
		;

	data_arrived = false;

	/* Read all data and echo it back */
	while ((*bytes_read = uart_fifo_read(dev,
	    (u8_t *)data_buf, sizeof(data_buf)))) {
		write_data(dev, data_buf, *bytes_read);
	}
	write_data(dev, &c, 1);
}
```

## src/usb_acm.h
```c
int usb_acm_setup(struct device **dev);
void interrupt_handler(struct device *dev);
void write_data(struct device *dev, const char *buf, int len);
void read_and_echo_data(struct device *dev, int *bytes_read);
```
